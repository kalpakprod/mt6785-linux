## Documentation/devicetree/bindings/media/mediatek,mt6785-seninf.yaml
```yaml
# SPDX-License-Identifier: (GPL-2.0-only OR BSD-2-Clause)
%YAML 1.2
---
$id: http://devicetree.org/schemas/media/mediatek,mt6785-seninf.yaml#
$schema: http://devicetree.org/meta-schemas/core.yaml#

title: MediaTek MT6785 SENINF CSI-2 receiver

maintainers:
  - devicetree@vger.kernel.org

description: |
  SENINF is the CSI-2 receiver and routing block of the MediaTek camera front
  end: it receives CSI-2 from the sensors, applies the per-receiver mux and
  routes the result through a global cam mux either to the closed image signal
  processor or to a CAMSV capture engine.

  On MT6785 the digital block starts at 0x1a040000 and holds one 0x1000 block
  per receiver, plus the top registers at the base itself; the analog receiver
  block starts at 0x11c80000 and is 0xc000 long. Both windows are in the live
  device tree of the Poco M5s (seninf1_csi2@1a040000, mipi_rx_ana_csi0a@11c80000)
  and in the vendor SENINF_MAP_BASE_REG/LENGTH_REG and
  SENINF_MAP_BASE_ANA/LENGTH_ANA constants.

properties:
  compatible:
    enum:
      - mediatek,mt6785-seninf

  reg:
    items:
      - description: digital registers
      - description: analog receiver registers

  reg-names:
    items:
      - const: seninf
      - const: ana

  clocks:
    maxItems: 1
    description: The SENINF gate, CLK_CAM_SENINF.

  clock-names:
    items:
      - const: seninf

  power-domains:
    maxItems: 1

  ports:
    $ref: /schemas/graph.yaml#/properties/ports

    patternProperties:
      '^port@[0-4]$':
        $ref: /schemas/graph.yaml#/$defs/port-base
        unevaluatedProperties: false
        description: Input from a sensor on the CSI port of the same number.

        properties:
          endpoint:
            $ref: /schemas/media/video-interfaces.yaml#
            unevaluatedProperties: false

            properties:
              data-lanes: true
              bus-type:
                enum:
                  - 1 # MIPI CSI-2 C-PHY
                  - 4 # MIPI CSI-2 D-PHY

      '^port@[5-9]$':
        $ref: /schemas/graph.yaml#/$defs/port-base
        unevaluatedProperties: false
        description: Output to a capture engine, one port per cam mux.

        properties:
          endpoint:
            $ref: /schemas/graph.yaml#/$defs/endpoint-base

required:
  - compatible
  - reg
  - reg-names
  - clocks
  - clock-names

additionalProperties: false

examples:
  - |
    #include <dt-bindings/clock/mediatek,mt6785-clk.h>
    #include <dt-bindings/power/mediatek,mt6785-power.h>

    soc {
        #address-cells = <2>;
        #size-cells = <2>;

        seninf: seninf@1a040000 {
            compatible = "mediatek,mt6785-seninf";
            reg = <0 0x1a040000 0 0xa000>,
                  <0 0x11c80000 0 0xc000>;
            reg-names = "seninf", "ana";
            clocks = <&camsys CLK_CAM_SENINF>;
            clock-names = "seninf";
            power-domains = <&spm MT6785_POWER_DOMAIN_CAM>;

            ports {
                #address-cells = <1>;
                #size-cells = <0>;

                port@0 {
                    reg = <0>;

                    endpoint {
                        remote-endpoint = <&sensor_out>;
                        data-lanes = <1 2 3 4>;
                    };
                };

                port@5 {
                    reg = <5>;

                    endpoint {
                        remote-endpoint = <&camsv_in>;
                    };
                };
            };
        };
    };
...
```

## Documentation/devicetree/bindings/misc/mediatek,mt6785-nvdata.yaml
```yaml
# SPDX-License-Identifier: (GPL-2.0-only OR BSD-2-Clause)
%YAML 1.2
---
$id: http://devicetree.org/schemas/misc/mediatek,mt6785-nvdata.yaml#
$schema: http://devicetree.org/meta-schemas/core.yaml#

title: MediaTek MT6785 factory addresses from a copied nvdata tree

maintainers:
  - The poco-m5s port <worker@poco.local>

description: |
  On this phone the Wi-Fi MAC address and the Bluetooth BD_ADDR are not in the
  firmware blobs and are not in the device tree: they live in the nvdata
  partition, which stock reads through MediaTek's nvram daemons. A mainline
  system must not read or write that partition (it is the phone's own factory
  data), so the driver reads a read-only copy of the two records instead and
  hands them to the radios that ask for them.

  The node carries no register window, no interrupt and no clock: it exists so
  that the driver is instantiated, and it reads
  /lib/firmware/rosemary/nvdata/APCFG/APRDEB/WIFI and .../BT_Addr through
  request_firmware().

properties:
  compatible:
    const: mediatek,mt6785-nvdata

required:
  - compatible

additionalProperties: false

examples:
  - |
    nvdata {
        compatible = "mediatek,mt6785-nvdata";
    };
```

## Documentation/devicetree/bindings/net/bluetooth/mediatek,mt6785-bt.yaml
```yaml
# SPDX-License-Identifier: (GPL-2.0-only OR BSD-2-Clause)
%YAML 1.2
---
$id: http://devicetree.org/schemas/net/bluetooth/mediatek,mt6785-bt.yaml#
$schema: http://devicetree.org/meta-schemas/core.yaml#

title: MediaTek MT6785 Bluetooth over the CONNSYS BTIF transport

maintainers:
  - The poco-m5s port <worker@poco.local>

description: |
  The MT6631 Bluetooth controller is a task on the CONNSYS MCU and has no bus
  of its own. HCI is carried as H4 inside STP frames of type 0 over the BTIF
  transport, so this node has no register window and no interrupt - it only
  tells the driver that the controller exists and should be brought up over
  the WMT stack.

properties:
  compatible:
    const: mediatek,mt6785-bt

required:
  - compatible

additionalProperties: false

examples:
  - |
    bluetooth {
        compatible = "mediatek,mt6785-bt";
    };
```

## Documentation/devicetree/bindings/net/wireless/mediatek,wifi.yaml
```yaml
# SPDX-License-Identifier: (GPL-2.0-only OR BSD-2-Clause)
%YAML 1.2
---
$id: http://devicetree.org/schemas/net/wireless/mediatek,wifi.yaml#
$schema: http://devicetree.org/meta-schemas/core.yaml#

title: MediaTek gen4m Wi-Fi HIF

maintainers:
  - The poco-m5s port <worker@poco.local>

description: |
  The Wi-Fi MAC and PHY live in the MT6631 companion die behind the SoC's
  CONNSYS. This node describes the HIF the gen4m driver binds - one CSR
  window, the WF_HIF interrupt and the DMA pool its buffers come from.

properties:
  compatible:
    const: mediatek,wifi

  reg:
    maxItems: 1

  interrupts:
    maxItems: 1

  memory-region:
    maxItems: 1

  power-domains:
    maxItems: 1

required:
  - compatible
  - reg
  - interrupts

additionalProperties: false

examples:
  - |
    #include <dt-bindings/interrupt-controller/arm-gic.h>
    #include <dt-bindings/interrupt-controller/irq.h>
    #include <dt-bindings/power/mediatek,mt6785-power.h>

    wifi@18000000 {
        compatible = "mediatek,wifi";
        reg = <0 0x18000000 0 0x100000>;
        interrupts = <GIC_SPI 322 IRQ_TYPE_LEVEL_LOW>;
        memory-region = <&wifi_mem>;
        power-domains = <&spm MT6785_POWER_DOMAIN_CONN>;
    };
```

## Documentation/devicetree/bindings/net/wwan/xiaomi,rosemary-ccci.yaml
```yaml
# SPDX-License-Identifier: (GPL-2.0-only OR BSD-2-Clause)
%YAML 1.2
---
$id: http://devicetree.org/schemas/net/wwan/xiaomi,rosemary-ccci.yaml#
$schema: http://devicetree.org/meta-schemas/core.yaml#

title: Xiaomi Poco M5s modem (MediaTek MT6785 MD1, CCCI over CCIF)

maintainers:
  - Poco M5s Linux port <noreply@example.invalid>

description: |
  The MediaTek MT6785 has a second processor for the modem (MD1), which the
  application processor reaches through two transports: CCIF for the control
  channels and DPMAIF for packet data. There is no CLDMA and no second modem on
  this part. The node collects the modem processor itself and the resources the
  AP driver needs to power it, to restart it and to reach its control registers.

  The share memory the modem uses is not described here: the bootloader reserves
  it and hands it to Linux with names of its own
  (mblock-<n>-ap_md_c_smem and so on), so the driver looks the regions up by
  name at run time.

properties:
  compatible:
    const: xiaomi,rosemary-ccci

  reg:
    items:
      - description: AP side of CCIF0
      - description: modem side of CCIF0

  reg-names:
    items:
      - const: ap-ccif
      - const: md-ccif

  interrupts:
    items:
      - description: CCIF data channels (level low)
      - description: CCIF exception channels (level low)
      - description: the modem's watchdog (edge falling)

  interrupt-names:
    items:
      - const: ccif
      - const: ccif-exception
      - const: md-wdt

  clocks:
    items:
      - description: CCIF0 AP gate
      - description: CCIF0 MD gate
      - description: CCIF1 AP gate
      - description: CCIF1 MD gate
      - description: CCIF2 AP gate
      - description: CCIF2 MD gate
      - description: CCIF4 MD gate

  clock-names:
    items:
      - const: infra-ccif-ap
      - const: infra-ccif-md
      - const: infra-ccif1-ap
      - const: infra-ccif1-md
      - const: infra-ccif2-ap
      - const: infra-ccif2-md
      - const: infra-ccif4-md

  power-domains:
    maxItems: 1

  vmodem-supply:
    description: The modem's buck supply.

  vsram-md-supply:
    description: The modem SRAM's LDO, which the vendor sets to 993 750 uV.

  mediatek,spm:
    $ref: /schemas/types.yaml#/definitions/phandle
    description: |
      Phandle to the SCPSYS system controller (syscon@10006000), whose
      PWR_STATUS register at +0x160 reports whether the modem's MTCMOS domain
      is on.

  mediatek,ccci-tag-base:
    $ref: /schemas/types.yaml#/definitions/uint32
    description: |
      Address of the bootloader's CCCI tag block, used only when the
      reservation it belongs to was not found by name.

  mediatek,dpmaif:
    $ref: /schemas/types.yaml#/definitions/phandle
    description: |
      Phandle to the DPMAIF node, the modem's packet data interface.

required:
  - compatible
  - reg
  - reg-names
  - interrupts
  - interrupt-names
  - clocks
  - clock-names
  - power-domains
  - vmodem-supply
  - vsram-md-supply
  - mediatek,spm

additionalProperties: false

examples:
  - |
    #include <dt-bindings/interrupt-controller/arm-gic.h>
    #include <dt-bindings/power/mediatek,mt6785-power.h>

    modem@10209000 {
        compatible = "xiaomi,rosemary-ccci";
        reg = <0 0x10209000 0 0x1000>,
              <0 0x1020a000 0 0x1000>;
        reg-names = "ap-ccif", "md-ccif";
        interrupts = <GIC_SPI 174 IRQ_TYPE_LEVEL_LOW>,
                     <GIC_SPI 175 IRQ_TYPE_LEVEL_LOW>,
                     <GIC_SPI 77 IRQ_TYPE_EDGE_FALLING>;
        interrupt-names = "ccif", "ccif-exception", "md-wdt";
        clocks = <&infracfg 43>, <&infracfg 46>, <&infracfg 36>,
                 <&infracfg 37>, <&infracfg 91>, <&infracfg 92>,
                 <&infracfg 104>;
        clock-names = "infra-ccif-ap", "infra-ccif-md",
                      "infra-ccif1-ap", "infra-ccif1-md",
                      "infra-ccif2-ap", "infra-ccif2-md",
                      "infra-ccif4-md";
        power-domains = <&spm MT6785_POWER_DOMAIN_MD>;
        vmodem-supply = <&vmodem>;
        vsram-md-supply = <&vsram_md>;
        mediatek,spm = <&scpsys>;
    };
```

## Documentation/devicetree/bindings/net/wwan/xiaomi,rosemary-dpmaif.yaml
```yaml
# SPDX-License-Identifier: (GPL-2.0-only OR BSD-2-Clause)
%YAML 1.2
---
$id: http://devicetree.org/schemas/net/wwan/xiaomi,rosemary-dpmaif.yaml#
$schema: http://devicetree.org/meta-schemas/core.yaml#

title: MediaTek MT6785 DPMAIF modem packet data interface (Poco M5s)

maintainers:
  - Poco M5s Linux port <noreply@example.invalid>

description: |
  DPMAIF is the hardware that moves the modem's packet data between the modem's
  network links and the application processor's DRAM. It is not a network
  device by itself: each of the modem's 22 interfaces becomes one, and the
  driver exposes them through the WWAN framework.

  The register block spans two power domains, so the node lists four windows:
  the always-on group carries the uplink registers at +0 and the downlink ones
  at +0x400; the power-domain group carries the uplink at +0, the downlink at
  +0x100 and the AP-misc block at +0x400; then the modem's own view of the
  interface, and its SRAM.

properties:
  compatible:
    const: xiaomi,rosemary-dpmaif

  reg:
    items:
      - description: always-on group, uplink and downlink
      - description: power-domain group, uplink, downlink and AP misc
      - description: the modem's own view
      - description: SRAM

  reg-names:
    items:
      - const: ao-ul
      - const: pd-ul
      - const: pd-md-misc
      - const: sram

  interrupts:
    maxItems: 1

  interrupt-names:
    const: dpmaif

  clocks:
    items:
      - description: the DPMAIF gate in infracfg_ao
      - description: the DPMAIF clock from topckgen

  clock-names:
    items:
      - const: infra-dpmaif
      - const: top-dpmaif

  mediatek,dpmaif-capability:
    $ref: /schemas/types.yaml#/definitions/uint32
    description: |
      The capability word the vendor driver reads. 6 on this part: the higher
      bits select the MT6297-only BAT/PIT reorder workarounds, which this chip
      does not have.

required:
  - compatible
  - reg
  - reg-names
  - interrupts
  - interrupt-names
  - clocks
  - clock-names

additionalProperties: false

examples:
  - |
    #include <dt-bindings/interrupt-controller/arm-gic.h>

    dpmaif@10014000 {
        compatible = "xiaomi,rosemary-dpmaif";
        reg = <0 0x10014000 0 0x1000>,
              <0 0x1022d000 0 0x1000>,
              <0 0x1022c000 0 0x1000>,
              <0 0x1022e000 0 0x1000>;
        reg-names = "ao-ul", "pd-ul", "pd-md-misc", "sram";
        interrupts = <GIC_SPI 199 IRQ_TYPE_LEVEL_HIGH>;
        interrupt-names = "dpmaif";
        clocks = <&infracfg 101>, <&topckgen 108>;
        clock-names = "infra-dpmaif", "top-dpmaif";
        mediatek,dpmaif-capability = <6>;
    };
```

## Documentation/devicetree/bindings/nvmem/mediatek,mt6785-devinfo.yaml
```yaml
# SPDX-License-Identifier: (GPL-2.0-only OR BSD-2-Clause)
%YAML 1.2
---
$id: http://devicetree.org/schemas/nvmem/mediatek,mt6785-devinfo.yaml#
$schema: http://devicetree.org/meta-schemas/core.yaml#

title: MediaTek eFuse copy passed by the bootloader (devinfo)

maintainers:
  - kalpak <kalpak@users.noreply.github.com>

description: |
  On MT6785 phones the eFuse block can be read only from the secure world.
  The bootloader copies the eFuse words the kernel needs into the /chosen
  property "atag,devinfo" (a u32 count, then the words). This node exposes
  that copy as NVMEM; word i of the vendor get_devinfo_with_index() array is
  at byte offset 4 * i.

allOf:
  - $ref: nvmem.yaml#
  - $ref: nvmem-deprecated-cells.yaml#

properties:
  $nodename:
    pattern: "^devinfo$"

  compatible:
    const: mediatek,mt6785-devinfo

required:
  - compatible

unevaluatedProperties: false

examples:
  - |
    devinfo {
        compatible = "mediatek,mt6785-devinfo";
        #address-cells = <1>;
        #size-cells = <1>;

        lvts-calib@1c0 {
            reg = <0x1c0 0x4>;
        };
    };
```

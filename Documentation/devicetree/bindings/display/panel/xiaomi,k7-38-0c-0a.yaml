## Documentation/devicetree/bindings/phy/mediatek,mt8365-csi-rx.yaml
```yaml
# SPDX-License-Identifier: (GPL-2.0-only OR BSD-2-Clause)
# Copyright (c) 2023 MediaTek, BayLibre
%YAML 1.2
---
$id: http://devicetree.org/schemas/phy/mediatek,mt8365-csi-rx.yaml#
$schema: http://devicetree.org/meta-schemas/core.yaml#

title: Mediatek Sensor Interface MIPI CSI CD-PHY

maintainers:
  - Julien Stephan <jstephan@baylibre.com>
  - Andy Hsieh <andy.hsieh@mediatek.com>

description:
  The SENINF CD-PHY is a set of CD-PHY connected to the SENINF CSI-2
  receivers. The number of PHYs depends on the SoC model.
  Depending on the SoC model, each PHYs can be either CD-PHY or D-PHY only
  capable.

  On MT6785 the analog receiver block starts at 0x11c80000 and holds one
  4 KB bank per CSI lane group, CSI0A at 0x11c80000, CSI0B at 0x11c81000,
  CSI1A at 0x11c82000, CSI1B at 0x11c83000, CSI2A at 0x11c84000 and CSI2B
  at 0x11c85000 (live device tree of the Poco M5s, nodes
  mipi_rx_ana_csi0a@11c80000 through mipi_rx_ana_csi2b@11c85000, and the
  ChromeOS isp_50 seninf register header, which annotates the same
  window). A node covers the A and B bank of one CSI port, that is 0x2000
  bytes from the port's A bank, because the driver drives the B bank at a
  fixed offset of 0x1000.

properties:
  compatible:
    enum:
      - mediatek,mt6785-csi-rx
      - mediatek,mt8365-csi-rx

  reg:
    maxItems: 1

  num-lanes:
    enum: [2, 3, 4]

  '#phy-cells':
    enum: [0, 1]
    description: |
      If the PHY doesn't support mode selection then #phy-cells must be 0 and
      PHY mode is described using phy-type property.
      If the PHY supports mode selection, then #phy-cells must be 1 and mode
      is set in the PHY cells. Supported modes are:
        - PHY_TYPE_DPHY
        - PHY_TYPE_CPHY
      See include/dt-bindings/phy/phy.h for constants.

  phy-type:
    description:
      If the PHY doesn't support mode selection then this set the operating mode.
      See include/dt-bindings/phy/phy.h for constants.
    const: 10
    $ref: /schemas/types.yaml#/definitions/uint32

required:
  - compatible
  - reg
  - num-lanes
  - '#phy-cells'

additionalProperties: false

examples:
  - |
    #include <dt-bindings/phy/phy.h>
    soc {
      #address-cells = <2>;
      #size-cells = <2>;

      csi0_rx: phy@11c10000 {
        compatible = "mediatek,mt8365-csi-rx";
        reg = <0 0x11c10000 0 0x2000>;
        num-lanes = <2>;
        #phy-cells = <1>;
      };

      csi1_rx: phy@11c12000 {
        compatible = "mediatek,mt8365-csi-rx";
        reg = <0 0x11c12000 0 0x2000>;
        phy-type = <PHY_TYPE_DPHY>;
        num-lanes = <2>;
        #phy-cells = <0>;
      };

      csi_rx: phy@11c80000 {
        compatible = "mediatek,mt6785-csi-rx";
        reg = <0 0x11c80000 0 0x2000>;
        num-lanes = <4>;
        #phy-cells = <1>;
      };
    };
...
```

## Documentation/devicetree/bindings/power/supply/lionsemi,ln8000.yaml
```yaml
# SPDX-License-Identifier: GPL-2.0-only OR BSD-2-Clause
%YAML 1.2
---
$id: http://devicetree.org/schemas/power/supply/lionsemi,ln8000.yaml#
$schema: http://devicetree.org/meta-schemas/core.yaml#

title: Lion Semiconductor LN8000 direct-charge pump

maintainers:
  - Poco M5s Linux port <noreply@example.invalid>

description: |
  The LN8000 is a switched-capacitor direct-charge pump used for fast charging
  next to the main charger. It has a standby mode, a 2:1 switching mode and a
  1:1 bypass mode, protections for input over-voltage, input over-current,
  battery over-voltage and die temperature, and an ADC for the input voltage
  and current and the die temperature. There is no public datasheet; the
  register map is taken from the GPL v2 vendor driver.

  Every property below is optional; when one is absent the value the chip
  powers up with is kept.

allOf:
  - $ref: power-supply.yaml#

properties:
  compatible:
    const: lionsemi,ln8000

  reg:
    maxItems: 1

  lionsemi,float-voltage-microvolt:
    description: |
      Battery float voltage in micro volts, in steps of 5000 micro volts.
    minimum: 3725000
    maximum: 5000000

  lionsemi,input-current-limit-microamp:
    description: |
      Input current limit in micro amps, in steps of 50000 micro amps.
    minimum: 500000
    maximum: 5000000

  lionsemi,input-overvoltage-microvolt:
    description: |
      Input over-voltage threshold in micro volts. The chip offers the levels
      6.5 V, 11 V, 12 V and 13 V; the largest level not above this value is
      used.
    minimum: 6500000
    maximum: 13000000

required:
  - compatible
  - reg

unevaluatedProperties: false

examples:
  - |
    i2c {
        #address-cells = <1>;
        #size-cells = <0>;

        charger@51 {
            compatible = "lionsemi,ln8000";
            reg = <0x51>;
            lionsemi,float-voltage-microvolt = <4350000>;
            lionsemi,input-current-limit-microamp = <2000000>;
            lionsemi,input-overvoltage-microvolt = <11000000>;
        };
    };
```

## Documentation/devicetree/bindings/power/supply/mediatek,mt6359-gauge.yaml
```yaml
# SPDX-License-Identifier: (GPL-2.0-only OR BSD-2-Clause)
%YAML 1.2
---
$id: http://devicetree.org/schemas/power/supply/mediatek,mt6359-gauge.yaml#
$schema: http://devicetree.org/meta-schemas/core.yaml#

title: MediaTek MT6359 PMIC fuel gauge

maintainers:
  - The poco-m5s port <worker@poco.local>

description: |
  The MT6359 PMIC's coulomb-counting fuel gauge. It reports the coulomb counter,
  current, battery voltage, battery temperature through the NTC on the PMIC's
  AUXADC BAT_TEMP channel, and a capacity anchored once per boot on the
  open-circuit voltage the bootloader measured.

properties:
  compatible:
    const: mediatek,mt6359-gauge

  monitored-battery:
    description: |
      The battery, described by the generic simple-battery binding
      (Documentation/devicetree/bindings/power/supply/battery.yaml): its
      ocv-capacity-table turns the anchored open-circuit voltage into a
      percentage, and charge-full-design-microamp-hours is the denominator for
      the coulomb counter afterwards. No private table properties are defined
      here - the generic ones carry everything this gauge needs.
    $ref: /schemas/types.yaml#/definitions/phandle

  io-channels:
    description: |
      The battery voltage channel ("vbat", in mV, as the generic adc-battery reads
      it on this board) and, optionally, the battery NTC ("ntc", the MT6359
      AUXADC's BAT_TEMP channel, a 12-bit code against a 4500 mV full scale).
    minItems: 1
    maxItems: 2

  io-channel-names:
    minItems: 1
    maxItems: 2

  mediatek,r-fg-value:
    description: |
      The sense resistor as the vendor battery profile carries it. The driver
      divides DEFAULT_R_FG (50) by it, so the vendor's 5 means the currents and
      charges are multiplied by ten.
    $ref: /schemas/types.yaml#/definitions/uint32

  mediatek,car-tune-value:
    description: |
      The vendor's current calibration factor, 100 for a correctly calibrated
      gauge (CAR_TUNE_VALUE in the vendor battery profile).
    $ref: /schemas/types.yaml#/definitions/uint32

  vdd-supply:
    description: The NTC divider's pull-up; the battery temperature is read through
      the PMIC's AUXADC BAT_TEMP channel and divided down against this rail.

required:
  - compatible

additionalProperties: false

examples:
  - |
    pmic {
        #address-cells = <1>;
        #size-cells = <0>;

        gauge {
            compatible = "mediatek,mt6359-gauge";
            monitored-battery = <&battery>;
            io-channels = <&adc 4>, <&pmic_adc 1>;
            io-channel-names = "vbat", "ntc";
            mediatek,r-fg-value = <5>;
            mediatek,car-tune-value = <100>;
        };
    };
```

## Documentation/devicetree/bindings/regulator/willsemi,wl2866d.yaml
```yaml
# SPDX-License-Identifier: GPL-2.0-only OR BSD-2-Clause
%YAML 1.2
---
$id: http://devicetree.org/schemas/regulator/willsemi,wl2866d.yaml#
$schema: http://devicetree.org/meta-schemas/core.yaml#

title: Wingtech/Will Semiconductor WL2866D camera LDO controller

maintainers:
  - devicetree@vger.kernel.org

description: |
  The WL2866D is a four-channel I2C low dropout regulator used on camera
  sensor modules. Two outputs (DVDD) span 0.6 V to 2.13 V in 6 mV steps with
  a 650 mA rating, two outputs (AVDD) span 1.2 V to 4.3875 V in 12.5 mV
  steps, and each output has its own enable bit in the shared enable
  register. One GPIO enables the whole part.

properties:
  compatible:
    enum:
      - willsemi,wl2866d

  reg:
    maxItems: 1

  vin-supply: true

  enable-gpios:
    maxItems: 1
    description:
      GPIO that enables the part. The pin is asserted (driven to its active
      level) while the chip is addressed, so describe it as active low when
      the board pulls the line low to power the part up.

  regulators:
    type: object
    description:
      Two DVDD and two AVDD outputs, named dvdd1, dvdd2, avdd1 and avdd2.

    patternProperties:
      "^dvdd[12]$":
        type: object
        $ref: regulator.yaml#
        unevaluatedProperties: false
        description:
          DVDD output, 600000 uV to 2130000 uV.

      "^avdd[12]$":
        type: object
        $ref: regulator.yaml#
        unevaluatedProperties: false
        description:
          AVDD output, 1200000 uV to 4387500 uV.

    additionalProperties: false

required:
  - compatible
  - reg
  - regulators

additionalProperties: false

examples:
  - |
    i2c {
        #address-cells = <1>;
        #size-cells = <0>;

        camera_ldo: regulator@28 {
            compatible = "willsemi,wl2866d";
            reg = <0x28>;
            enable-gpios = <&pio 195 GPIO_ACTIVE_LOW>;

            regulators {
                dvdd1 {
                    regulator-name = "wl2866d_dvdd1";
                    regulator-min-microvolt = <600000>;
                    regulator-max-microvolt = <2130000>;
                };

                dvdd2 {
                    regulator-name = "wl2866d_dvdd2";
                    regulator-min-microvolt = <600000>;
                    regulator-max-microvolt = <2130000>;
                };

                avdd1 {
                    regulator-name = "wl2866d_avdd1";
                    regulator-min-microvolt = <1200000>;
                    regulator-max-microvolt = <4387500>;
                };

                avdd2 {
                    regulator-name = "wl2866d_avdd2";
                    regulator-min-microvolt = <1200000>;
                    regulator-max-microvolt = <4387500>;
                };
            };
        };
    };
...
```

## Documentation/devicetree/bindings/regulator/wl2866d.yaml
```yaml
# SPDX-License-Identifier: (GPL-2.0-only OR BSD-2-Clause)
%YAML 1.2
---
$id: http://devicetree.org/schemas/regulator/wl2866d.yaml#
$schema: http://devicetree.org/meta-schemas/core.yaml#

title: Will Semiconductor WL2866D four-output LDO controller

maintainers:
  - poco-display-worker <worker@poco.local>

description: |
  The WL2866D is an I2C-controlled four-output LDO used to feed camera sensor
  supplies on several phones. Outputs 0 and 1 cover 0.6-2.13 V in 6 mV steps,
  outputs 2 and 3 cover 1.2-4.3875 V in 12.5 mV steps, and one GPIO enables the
  part as a whole.

properties:
  compatible:
    const: xiaomi,wl2866d

  reg:
    maxItems: 1

  en-gpios:
    description: Enable GPIO of the controller, active low on the boards seen so far.
    maxItems: 1

  regulators:
    type: object
    description: The four outputs, named by the board's supply names.
    additionalProperties: false

    patternProperties:
      "^dvdd[12]$":
        type: object
        $ref: regulator.yaml#
        unevaluatedProperties: false

      "^avdd[12]$":
        type: object
        $ref: regulator.yaml#
        unevaluatedProperties: false

required:
  - compatible
  - reg
  - regulators

additionalProperties: false

examples:
  - |
    i2c {
        #address-cells = <1>;
        #size-cells = <0>;

        regulator@28 {
            compatible = "xiaomi,wl2866d";
            reg = <0x28>;

            regulators {
                dvdd1 {
                    regulator-name = "wl2866d_dvdd1";
                    regulator-min-microvolt = <600000>;
                    regulator-max-microvolt = <2130000>;
                    regulator-boot-on;
                };

                dvdd2 {
                    regulator-name = "wl2866d_dvdd2";
                    regulator-min-microvolt = <600000>;
                    regulator-max-microvolt = <2130000>;
                };

                avdd1 {
                    regulator-name = "wl2866d_avdd1";
                    regulator-min-microvolt = <1200000>;
                    regulator-max-microvolt = <4387500>;
                };

                avdd2 {
                    regulator-name = "wl2866d_avdd2";
                    regulator-min-microvolt = <1200000>;
                    regulator-max-microvolt = <4387500>;
                };
            };
        };
    };
...
```

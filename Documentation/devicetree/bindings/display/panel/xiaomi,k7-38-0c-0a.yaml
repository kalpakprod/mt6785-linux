## Documentation/devicetree/bindings/display/panel/xiaomi,k7-38-0c-0a.yaml
```yaml
# SPDX-License-Identifier: GPL-2.0-only OR BSD-2-Clause
%YAML 1.2
---
$id: http://devicetree.org/schemas/display/panel/xiaomi,k7-38-0c-0a.yaml#
$schema: http://devicetree.org/meta-schemas/core.yaml#

title: Xiaomi K7 38-0c-0a 6.7" 1080x2400 AMOLED MIPI-DSI panel

maintainers:
  - Poco M5s Linux port <noreply@example.invalid>

description: |
  The Xiaomi "k7 38 0c 0a" is a 6.7 inch 1080x2400 AMOLED module, 67 x 149 mm,
  driven by a FocalTech FT3418-class display driver IC and used in the POCO M5s
  and the Redmi Note 10S. It is a video mode panel with sync pulses, four DSI
  lanes and RGB888, and takes its brightness over DCS 0x51 (11 bits): there is
  no backlight LED string and no PWM input.

allOf:
  - $ref: panel-common.yaml#

properties:
  compatible:
    const: xiaomi,k7-38-0c-0a

  reg:
    maxItems: 1

  vddi-supply:
    description: 1.8 V I/O supply rail (VDDI)

  vdd-supply:
    description: 3.0 V analogue supply rail (AVDD and ELVDD)

  reset-gpios: true
  port: true

required:
  - compatible
  - reg
  - vddi-supply
  - vdd-supply
  - reset-gpios
  - port

additionalProperties: false

examples:
  - |
    #include <dt-bindings/gpio/gpio.h>

    dsi {
        #address-cells = <1>;
        #size-cells = <0>;

        panel@0 {
            compatible = "xiaomi,k7-38-0c-0a";
            reg = <0>;
            vddi-supply = <&panel_vddi>;
            vdd-supply = <&panel_avdd>;
            reset-gpios = <&pio 44 GPIO_ACTIVE_LOW>;
            backlight = <&backlight>;

            port {
                endpoint {
                    remote-endpoint = <&dsi_out>;
                };
            };
        };
    };
...
```

## Documentation/devicetree/bindings/gnss/mediatek,mt6785-stpgps.yaml
```yaml
# SPDX-License-Identifier: (GPL-2.0-only OR BSD-2-Clause)
%YAML 1.2
---
$id: http://devicetree.org/schemas/gnss/mediatek,mt6785-stpgps.yaml#
$schema: http://devicetree.org/meta-schemas/core.yaml#

title: MediaTek MT6785 GNSS bridge over the CONNSYS STP transport

maintainers:
  - The poco-m5s port <worker@poco.local>

description: |
  The MT6631 GNSS engine is a task on the CONNSYS MCU. Its data arrives as STP
  frames of type 2 over the BTIF transport, so this node has no register window
  of its own; the driver creates /dev/stpgps for the data path and /dev/gps_emi
  as the EMI-window placeholder the vendor userspace daemon expects.

properties:
  compatible:
    const: mediatek,mt6785-stpgps

required:
  - compatible

additionalProperties: false

examples:
  - |
    gnss {
        compatible = "mediatek,mt6785-stpgps";
    };
```

## Documentation/devicetree/bindings/input/awinic,aw8622.yaml
```yaml
# SPDX-License-Identifier: (GPL-2.0-only OR BSD-2-Clause)
%YAML 1.2
---
$id: http://devicetree.org/schemas/input/awinic,aw8622.yaml#
$schema: http://devicetree.org/meta-schemas/core.yaml#

title: Awinic AW8622 linear resonant actuator driver

maintainers:
  - MediaTek SoC Team <linux-mediatek@lists.infradead.org>

description: |
  The AW8622 drives a linear resonant actuator (LRA). Its PWM input takes a
  square wave at the actuator's resonance frequency and the duty cycle of that
  wave sets the strength of the vibration, so the device is described as a PWM
  consumer plus the chip's enable pin.

properties:
  compatible:
    const: awinic,aw8622

  hwen-gpios:
    description: The chip's HWEN input, which enables the amplifier.

  pwms:
    maxItems: 1

  awinic,vibration-frequency-hz:
    description: Resonance frequency of the actuator, in Hz.
    default: 208

  pinctrl-0: true
  pinctrl-names: true

required:
  - compatible
  - hwen-gpios
  - pwms

additionalProperties: false

examples:
  - |
    #include <dt-bindings/gpio/gpio.h>

    haptics {
        compatible = "awinic,aw8622";
        hwen-gpios = <&pio 202 GPIO_ACTIVE_HIGH>;
        pwms = <&pwm0 0 4807692>;
        awinic,vibration-frequency-hz = <208>;
    };

    pio: pinctrl {
        gpio-controller;
        #gpio-cells = <2>;
    };

    pwm0: pwm {
        #pwm-cells = <2>;
    };

...
```

## Documentation/devicetree/bindings/input/goodix,gf3626-fp.yaml
```yaml
# SPDX-License-Identifier: (GPL-2.0-only OR BSD-2-Clause)
%YAML 1.2
---
$id: http://devicetree.org/schemas/input/goodix,gf3626-fp.yaml#
$schema: http://devicetree.org/meta-schemas/core.yaml#

title: Goodix GF3626 side fingerprint sensor (oswego_m family)

maintainers:
  - Poco M5s Linux port <noreply@example.invalid>

description: |
  The GF3626 is a capacitive fingerprint sensor that sits in the power button
  of the phone (Goodix's oswego_m family). It is connected to the SoC over SPI,
  with a reset line, an active-high interrupt line and its own 3.3 V supply.

  The sensor is not driven from Linux: the fingerprint trusted application in
  the Microtrust secure world owns the SPI controller and performs every sensor
  transfer. The node describes only the wiring the normal world must set up --
  the supply, the reset pulse and the interrupt that the secure world's
  transfers are announced with.

properties:
  compatible:
    const: goodix,gf3626-fp

  reg:
    maxItems: 1

  interrupts:
    maxItems: 1
    description: |
      Interrupt line from the sensor, edge triggered on the rising edge. Used
      as the "a finger is on the sensor" notification for user space.

  reset-gpios:
    maxItems: 1
    description: |
      Reset line of the sensor, active low: holding it low resets the sensor,
      the driver pulses it low for 15 ms and then releases it.

  vfp-supply:
    description: 3.3 V supply of the sensor (VFP).

  spi-max-frequency:
    maximum: 1000000

required:
  - compatible
  - reg
  - interrupts
  - reset-gpios
  - vfp-supply

allOf:
  - $ref: /schemas/spi/spi-peripheral-props.yaml#

unevaluatedProperties: false

examples:
  - |
    #include <dt-bindings/gpio/gpio.h>
    #include <dt-bindings/interrupt-controller/irq.h>

    spi {
      #address-cells = <1>;
      #size-cells = <0>;

      fingerprint@0 {
        compatible = "goodix,gf3626-fp";
        reg = <0>;
        spi-max-frequency = <1000000>;
        interrupt-parent = <&pio>;
        interrupts = <5 IRQ_TYPE_EDGE_RISING>;
        reset-gpios = <&pio 30 GPIO_ACTIVE_LOW>;
        vfp-supply = <&mt6360_vfp>;
      };
    };

...
```

## Documentation/devicetree/bindings/input/touchscreen/focaltech,ft3418.yaml
```yaml
# SPDX-License-Identifier: GPL-2.0-only OR BSD-2-Clause
%YAML 1.2
---
$id: http://devicetree.org/schemas/input/touchscreen/focaltech,ft3418.yaml#
$schema: http://devicetree.org/meta-schemas/core.yaml#

title: FocalTech FT3418 incell AMOLED touchscreen controller

maintainers:
  - Poco M5s Linux port <noreply@example.invalid>

description: |
  The FT3418 is a FocalTech incell touch controller that sits behind AMOLED
  panels, for example the Xiaomi "k7 38 0c 0a" of the POCO M5s and the Redmi
  Note 10S. It answers on I2C with chip id 0x54/0x52 and reports up to ten
  contact points through its 63 byte frame; it is not an FT5x06-family part.

allOf:
  - $ref: touchscreen.yaml#

properties:
  compatible:
    const: focaltech,ft3418

  reg:
    maxItems: 1

  interrupts:
    maxItems: 1

  reset-gpios:
    maxItems: 1
    description: active low reset line

  vdd-supply:
    description: 3.0 V analogue supply rail

  iovdd-supply:
    description: 1.8 V I/O supply rail, when the board describes it

required:
  - compatible
  - reg
  - interrupts
  - reset-gpios

unevaluatedProperties: false

examples:
  - |
    #include <dt-bindings/gpio/gpio.h>
    #include <dt-bindings/interrupt-controller/irq.h>

    i2c {
        #address-cells = <1>;
        #size-cells = <0>;

        touchscreen@38 {
            compatible = "focaltech,ft3418";
            reg = <0x38>;
            interrupt-parent = <&pio>;
            interrupts = <1 IRQ_TYPE_EDGE_FALLING>;
            reset-gpios = <&pio 2 GPIO_ACTIVE_LOW>;
            vdd-supply = <&vtouch>;
            touchscreen-size-x = <1080>;
            touchscreen-size-y = <2400>;
        };
    };
...
```

## Documentation/devicetree/bindings/media/i2c/galaxycore,gc02m1.yaml
```yaml
# SPDX-License-Identifier: (GPL-2.0-only OR BSD-2-Clause)
%YAML 1.2
---
$id: http://devicetree.org/schemas/media/i2c/galaxycore,gc02m1.yaml#
$schema: http://devicetree.org/meta-schemas/core.yaml#

title: GalaxyCore GC02M1 2 megapixel image sensor

maintainers:
  - devicetree@vger.kernel.org

description: |
  The GC02M1 is a 2 megapixel CMOS image sensor with a single-lane MIPI CSI-2
  output. The Poco M5s fits it as its macro camera, and the same board can
  carry the OV02B1B instead as the depth camera, so a board describes
  whichever part it has.

allOf:
  - $ref: /schemas/media/video-interface-devices.yaml#

properties:
  compatible:
    const: galaxycore,gc02m1

  reg:
    maxItems: 1

  clocks:
    maxItems: 1
    description: External clock (XCLK) of the sensor.

  clock-names:
    items:
      - const: xclk

  avdd-supply:
    description: Analog power supply.

  dvdd-supply:
    description:
      Digital core power supply. Boards that feed the core from an internal
      regulator, or from the same rail as AVDD, leave this out - the Poco M5s
      wires only AVDD and DOVDD to its 2 MP modules.

  dovdd-supply:
    description: I/O power supply.

  reset-gpios:
    maxItems: 1
    description: Active-low reset line.

  port:
    $ref: /schemas/graph.yaml#/$defs/port-base
    additionalProperties: false

    properties:
      endpoint:
        $ref: /schemas/media/video-interfaces.yaml#
        unevaluatedProperties: false

        properties:
          data-lanes:
            items:
              - const: 1

        required:
          - data-lanes

    required:
      - endpoint

required:
  - compatible
  - reg
  - clocks
  - avdd-supply
  - reset-gpios
  - port

additionalProperties: false

examples:
  - |
    #include <dt-bindings/gpio/gpio.h>

    i2c {
        #address-cells = <1>;
        #size-cells = <0>;

        camera@37 {
            compatible = "galaxycore,gc02m1";
            reg = <0x37>;

            clocks = <&topckgen 78>;
            clock-names = "xclk";
            assigned-clock-rates = <24000000>;

            avdd-supply = <&cam_avdd1>;
            dovdd-supply = <&mt6359_vcamio_ldo_reg>;

            reset-gpios = <&pio 119 GPIO_ACTIVE_LOW>;

            port {
                endpoint {
                    data-lanes = <1>;
                    remote-endpoint = <&seninf_macro_in>;
                };
            };
        };
    };
...
```

## Documentation/devicetree/bindings/media/i2c/ovti,ov13b10.yaml
```yaml
# SPDX-License-Identifier: (GPL-2.0-only OR BSD-2-Clause)
%YAML 1.2
---
$id: http://devicetree.org/schemas/media/i2c/ovti,ov13b10.yaml#
$schema: http://devicetree.org/meta-schemas/core.yaml#

title: Omnivision OV13B10 CMOS sensor

maintainers:
  - poco-display-worker <worker@poco.local>

description: |
  The OV13B10 is a 13 megapixel 4-lane MIPI CSI-2 sensor. The driver takes three supplies,
  one memory clock and one reset line, and the endpoint describes the four data lanes and the
  link frequency the sensor is configured for.

properties:
  compatible:
    const: ovti,ov13b10

  reg:
    maxItems: 1

  clocks:
    maxItems: 1

  avdd-supply:
    description: Analog power supply (2.8 V on the boards seen so far).

  dvdd-supply:
    description: Digital core power supply (1.2 V).

  dovdd-supply:
    description: Digital I/O power supply (1.8 V).

  reset-gpios:
    maxItems: 1

  port:
    $ref: /schemas/graph.yaml#/$defs/port-base
    additionalProperties: false

    properties:
      endpoint:
        $ref: /schemas/media/video-interfaces.yaml#
        unevaluatedProperties: false

        properties:
          data-lanes:
            oneOf:
              - items:
                  - const: 1
                  - const: 2
                  - const: 3
                  - const: 4
          link-frequencies: true

        required:
          - data-lanes
          - link-frequencies

    required:
      - endpoint

required:
  - compatible
  - reg
  - clocks
  - avdd-supply
  - dvdd-supply
  - dovdd-supply
  - port

additionalProperties: false

examples:
  - |
    #include <dt-bindings/gpio/gpio.h>

    i2c {
        #address-cells = <1>;
        #size-cells = <0>;

        camera@36 {
            compatible = "ovti,ov13b10";
            reg = <0x36>;

            clocks = <&cam_clk>;

            avdd-supply = <&avdd>;
            dvdd-supply = <&dvdd>;
            dovdd-supply = <&dovdd>;
            reset-gpios = <&pio 124 GPIO_ACTIVE_LOW>;

            port {
                endpoint {
                    link-frequencies = /bits/ 64 <560000000>;
                    data-lanes = <1 2 3 4>;
                };
            };
        };
    };
...
```

## Documentation/devicetree/bindings/media/mediatek,mt6785-camsv.yaml
```yaml
# SPDX-License-Identifier: (GPL-2.0-only OR BSD-2-Clause)
%YAML 1.2
---
$id: http://devicetree.org/schemas/media/mediatek,mt6785-camsv.yaml#
$schema: http://devicetree.org/meta-schemas/core.yaml#

title: MediaTek MT6785 CAMSV capture engine

maintainers:
  - devicetree@vger.kernel.org

description: |
  CAMSV is the small capture engine of the MediaTek camera front end: a
  timing generator, a packer and one DMA that writes a raw frame to memory.
  MT6785 has six of them at 0x1a050000 + 0x1000 * n, each with its own
  interrupt (live device tree of the Poco M5s: camsv1@1a050000 ...
  camsv6@1a055000). The engine captures the frame that SENINF routes to it,
  so the frame size is a property of the sensor mode and is described here
  until the media graph can provide it.

properties:
  compatible:
    enum:
      - mediatek,mt6785-camsv

  reg:
    maxItems: 1

  interrupts:
    maxItems: 1

  clocks:
    maxItems: 1
    description:
      The engine's gate, CLK_CAM_SV0 for CAMSV0 and CLK_CAM_SV1 for CAMSV1.

  clock-names:
    items:
      - const: camsv

  power-domains:
    maxItems: 1

  width:
    description: Frame width the engine captures, in pixels.
    $ref: /schemas/types.yaml#/definitions/uint32

  height:
    description: Frame height the engine captures, in lines.
    $ref: /schemas/types.yaml#/definitions/uint32

  port:
    $ref: /schemas/graph.yaml#/$defs/port-base
    additionalProperties: false
    description:
      Input from SENINF. The link is created when the SENINF driver is
      present; the engine works without it (physical addressing, its own
      timing generator), which is why a node without a port is valid.

    properties:
      endpoint:
        $ref: /schemas/graph.yaml#/$defs/endpoint-base
        unevaluatedProperties: false

        properties:
          data-lanes: true

required:
  - compatible
  - reg
  - interrupts
  - clocks
  - clock-names
  - width
  - height

additionalProperties: false

examples:
  - |
    #include <dt-bindings/clock/mediatek,mt6785-clk.h>
    #include <dt-bindings/interrupt-controller/arm-gic.h>
    #include <dt-bindings/power/mediatek,mt6785-power.h>

    soc {
        #address-cells = <2>;
        #size-cells = <2>;

        camsv0: camsv@1a050000 {
            compatible = "mediatek,mt6785-camsv";
            reg = <0 0x1a050000 0 0x1000>;
            interrupts = <GIC_SPI 247 IRQ_TYPE_LEVEL_HIGH>;
            clocks = <&camsys CLK_CAM_SV0>;
            clock-names = "camsv";
            power-domains = <&spm MT6785_POWER_DOMAIN_CAM>;
            width = <3280>;
            height = <2464>;
        };
    };
...
```

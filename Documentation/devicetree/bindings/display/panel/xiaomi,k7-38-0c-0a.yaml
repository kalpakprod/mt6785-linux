## Documentation/devicetree/bindings/remoteproc/mediatek,mt6785-scp-cm4.yaml
```yaml
# SPDX-License-Identifier: (GPL-2.0-only OR BSD-2-Clause)
%YAML 1.2
---
$id: http://devicetree.org/schemas/remoteproc/mediatek,mt6785-scp-cm4.yaml#
$schema: http://devicetree.org/meta-schemas/core.yaml#

title: Mediatek MT6785 System Companion Processor (Cortex-M4)

maintainers:
  - Pi phone port <worker@poco.local>

description:
  The MT6785 SCP is a Cortex-M4 that runs the tinysys "CM4" firmware, which
  drives the motion and environment sensors on its own I2C buses.  Unlike the
  RISC-V SCP of later SoCs it has no mailbox pins and no virtio; the IPI and the
  ready handshake go through share objects in its SRAM.

  The firmware is loaded by the bootloader, not by Linux.  The bootloader reads
  this node (compatible "mediatek,scp" and its status) and the properties
  documented below as "read by the bootloader", reserves the image carriage-out
  and fills the region info in SCP SRAM.  Linux reads that back and releases
  the core.

properties:
  compatible:
    items:
      - const: mediatek,mt6785-scp
      - const: mediatek,scp
        description: matched by the bootloader, which then loads the firmware.

  reg:
    items:
      - description: SCP SRAM (the TCM the firmware runs from)
      - description: SCP configuration registers
      - description: SCP clock control registers
      - description: SCP L1 cache control registers

  reg-names:
    items:
      - const: sram
      - const: cfg
      - const: clkctrl
      - const: l1cctrl

  clocks:
    items:
      - description: SCP clock (the top mux feeding the core)
      - description: SCP bus gate

  clock-names:
    items:
      - const: main
      - const: infra

  interrupts:
    maxItems: 1
    description: SCP-to-AP interrupt, used for the ready handshake and IPI.

  memory-region:
    maxItems: 1
    description:
      The DRAM block the firmware and the AP share (the sensor hub's FIFO and
      the logger).  When it is absent the driver looks the reservation up by
      its compatible, "mediatek,reserve-memory-scp_share".

  mediatek,infracfg:
    $ref: /schemas/types.yaml#/definitions/phandle
    description:
      Phandle to the infracfg syscon, whose IRQ-set register carries the AP
      awake lock the AP takes before it touches the SCP's mailbox SRAM.

  core_1:
    $ref: /schemas/types.yaml#/definitions/string
    description: read by the bootloader; "enable" starts the second core.

  scp_sramSize:
    $ref: /schemas/types.yaml#/definitions/uint32
    description: read by the bootloader; size of the SCP SRAM in bytes.

  scp_mpuRegionId:
    $ref: /schemas/types.yaml#/definitions/uint32
    description: read by the bootloader; the EMI MPU region the SCP may use.

  scp_feature_tbl:
    $ref: /schemas/types.yaml#/definitions/uint32-array
    description:
      read by the bootloader; pairs of feature id and the frequency in MHz it
      needs.

  scp_mem_key:
    $ref: /schemas/types.yaml#/definitions/string
    description:
      read by the bootloader; compatible of the reserved-memory node that
      holds the shared DRAM blocks.

  scp_mem_tbl:
    $ref: /schemas/types.yaml#/definitions/uint32-array
    description:
      read by the bootloader; pairs of DRAM block id (in the order of the
      firmware's block table) and its size in bytes.

required:
  - compatible
  - reg
  - reg-names
  - interrupts

additionalProperties: false

examples:
  - |
    #include <dt-bindings/interrupt-controller/arm-gic.h>
    #include <dt-bindings/interrupt-controller/irq.h>
    #include <dt-bindings/clock/mediatek,mt6785-clk.h>

    scp@10500000 {
        compatible = "mediatek,mt6785-scp", "mediatek,scp";
        reg = <0x10500000 0xc0000>,
              <0x105c0000 0x3000>,
              <0x105c4000 0x1000>,
              <0x105d4000 0x6000>;
        reg-names = "sram", "cfg", "clkctrl", "l1cctrl";
        interrupts = <GIC_SPI 201 IRQ_TYPE_LEVEL_HIGH>;
        clocks = <&topckgen CLK_TOP_SCP>, <&infracfg CLK_INFRA_SCP>;
        clock-names = "main", "infra";
        mediatek,infracfg = <&infracfg>;
        core_1 = "enable";
        scp_sramSize = <0xc0000>;
        scp_mpuRegionId = <0x07>;
        scp_feature_tbl = <0x00 0x05 0x01 0x164 0x02 0x3e>;
        scp_mem_key = "mediatek,reserve-memory-scp_share";
        scp_mem_tbl = <0x00 0x49200 0x01 0x100000 0x04 0x180000>;
        status = "okay";
    };
```

## Documentation/devicetree/bindings/reserved-memory/mediatek,consys-reserve-memory.yaml
```yaml
# SPDX-License-Identifier: (GPL-2.0-only OR BSD-2-Clause)
%YAML 1.2
---
$id: http://devicetree.org/schemas/reserved-memory/mediatek,consys-reserve-memory.yaml#
$schema: http://devicetree.org/meta-schemas/core.yaml#

title: MediaTek CONNSYS firmware memory

maintainers:
  - The poco-m5s port <worker@poco.local>

description:
  The conn MCU runs its firmware from a carve-out of DRAM that the kernel
  must not use. The bootloader picks the address inside alloc-ranges and the
  driver finds the region by its compatible string; the MCU also needs the
  physical address written into its own register window, which the driver
  does at bring-up.

properties:
  compatible:
    const: mediatek,consys-reserve-memory

  reg: true
  size: true
  alignment: true
  alloc-ranges: true
  no-map: true

required:
  - compatible
  - size

additionalProperties: false

examples:
  - |
    reserved-memory {
        #address-cells = <2>;
        #size-cells = <2>;
        ranges;

        consys-reserve-memory {
            compatible = "mediatek,consys-reserve-memory";
            no-map;
            size = <0 0x400000>;
            alignment = <0 0x1000000>;
            alloc-ranges = <0 0x40000000 0 0x80000000>;
        };
    };
```

## Documentation/devicetree/bindings/reserved-memory/mediatek,reserve-memory-scp_share.yaml
```yaml
# SPDX-License-Identifier: (GPL-2.0-only OR BSD-2-Clause)
%YAML 1.2
---
$id: http://devicetree.org/schemas/reserved-memory/mediatek,reserve-memory-scp_share.yaml#
$schema: http://devicetree.org/meta-schemas/core.yaml#

title: MediaTek SCP shared DRAM

maintainers:
  - Pi phone port <worker@poco.local>

description: |
  DRAM the System Companion Processor (SCP) and the AP share: the SCP firmware
  keeps its sensor hub event FIFO and its log ring here, and the AP side of the
  hub driver maps the same bytes.  The region is found by its compatible
  (mediatek,reserve-memory-scp_share, the SoC node's scp_mem_key), and the
  driver splits it into the fixed blocks the firmware's scp_mem_tbl describes.

  It is a dynamic reserved-memory node (size, alignment and alloc-ranges, no
  reg): the address is chosen by the boot or by the kernel's reserved-memory
  allocator, so the node can never overlap one of the bootloader's own
  reservations.

allOf:
  - $ref: reserved-memory.yaml

properties:
  compatible:
    const: mediatek,reserve-memory-scp_share

required:
  - compatible

unevaluatedProperties: false

examples:
  - |
    reserved-memory {
        #address-cells = <2>;
        #size-cells = <2>;

        scp-share {
            compatible = "mediatek,reserve-memory-scp_share";
            no-map;
            size = <0x00 0x400000>;
            alignment = <0x00 0x1000000>;
            alloc-ranges = <0x00 0x40000000 0x00 0x50000000>;
        };
    };
```

## Documentation/devicetree/bindings/serial/mediatek,btif.yaml
```yaml
# SPDX-License-Identifier: (GPL-2.0-only OR BSD-2-Clause)
%YAML 1.2
---
$id: http://devicetree.org/schemas/serial/mediatek,btif.yaml#
$schema: http://devicetree.org/meta-schemas/core.yaml#

title: MediaTek BTIF (Bluetooth Interface) transport

maintainers:
  - The poco-m5s port <worker@poco.local>

description:
  A 16550-shaped register block plus an AP-DMA descriptor pair in each
  direction. On MT6785 it carries the WMT/STP control channel to the
  CONNSYS MCU and the Bluetooth H4 data path; the UART and SDIO STP
  transports do not exist on this SoC.

properties:
  compatible:
    const: mediatek,btif

  reg:
    description: The BTIF register block, then the TX and RX DMA windows.
    minItems: 3
    maxItems: 3

  reg-names:
    items:
      - const: btif
      - const: tx_dma
      - const: rx_dma

  interrupts:
    description: BTIF, TX DMA done and RX DMA done.
    minItems: 3
    maxItems: 3

  clocks:
    maxItems: 2

  clock-names:
    items:
      - const: btifc
      - const: apdmac

required:
  - compatible
  - reg
  - interrupts
  - clocks
  - clock-names

additionalProperties: false

examples:
  - |
    #include <dt-bindings/interrupt-controller/arm-gic.h>
    #include <dt-bindings/interrupt-controller/irq.h>
    #include <dt-bindings/clock/mediatek,mt6785-clk.h>

    btif@1100c000 {
        compatible = "mediatek,btif";
        reg = <0 0x1100c000 0 0x1000>,
              <0 0x11000b80 0 0x80>,
              <0 0x11000c00 0 0x80>;
        interrupts = <GIC_SPI 138 IRQ_TYPE_LEVEL_LOW>,
                     <GIC_SPI 155 IRQ_TYPE_LEVEL_LOW>,
                     <GIC_SPI 154 IRQ_TYPE_LEVEL_LOW>;
        clocks = <&infracfg CLK_INFRA_BTIF>,
                 <&infracfg CLK_INFRA_AP_DMA>;
        clock-names = "btifc", "apdmac";
    };
```

## Documentation/devicetree/bindings/soc/mediatek/mediatek,mt6785-consys.yaml
```yaml
# SPDX-License-Identifier: (GPL-2.0-only OR BSD-2-Clause)
%YAML 1.2
---
$id: http://devicetree.org/schemas/soc/mediatek/mediatek,mt6785-consys.yaml#
$schema: http://devicetree.org/meta-schemas/core.yaml#

title: MediaTek MT6785 CONNSYS (connectivity subsystem)

maintainers:
  - The poco-m5s port <worker@poco.local>

description:
  The MT6785 connectivity subsystem hosts the conn MCU that runs Wi-Fi,
  Bluetooth, GNSS and FM on the MT6631 companion die. This node carries the
  register windows the WMT driver maps by index, the three interrupts, the
  CCIF clock gate, the conn power domain, the reserved memory the MCU
  firmware is placed in, and the A-die supplies.

properties:
  compatible:
    const: mediatek,mt6785-consys

  '#address-cells':
    const: 2

  '#size-cells':
    const: 2

  ranges: true

  reg:
    description: >
      Twelve register windows in this exact order - the vendor driver maps
      them by index (MCU, TOP_RGU, INFRACFG_AO, SPM, CONN_HIF_ON,
      TOP_MISC_OFF, MCU_CFG_ON, MCU_CIRQ, TOP_MISC_ON, CONN_HIF_PDMA,
      AP_PCCIF4, INFRA_AO_PERICFG).
    minItems: 12
    maxItems: 12

  reg-names:
    items:
      - const: mcu
      - const: top_rgu
      - const: infra_ao
      - const: spm
      - const: conn_hif_on
      - const: top_misc_off
      - const: mcu_cfg_on
      - const: mcu_cirq
      - const: top_misc_on
      - const: conn_hif_pdma
      - const: ap_pccif4
      - const: infra_ao_pericfg

  interrupts:
    description: BGF_EINT, WDT_EINT and the conn-to-AP software interrupt.
    minItems: 3
    maxItems: 3

  clocks:
    maxItems: 1

  clock-names:
    const: ccif

  power-domains:
    maxItems: 1

  memory-region:
    maxItems: 1

  pmic:
    $ref: /schemas/types.yaml#/definitions/phandle
    description: >
      MT6359 PMIC, used for the A-die LDO and the conn clock buffer. The
      vendor driver looks this property up by its short name.

  vcn18-supply:
    description: A-die 1.8 V rail.

  vcn33_1_wifi-supply:
    description: A-die 3.3 V rail feeding the RF and PLL.

  vcn33_2_wifi-supply:
    description: A-die 2.8 V rail.

  pinctrl-names:
    items:
      - const: default
      - const: gps_lna_state_init
      - const: gps_lna_state_oh
      - const: gps_lna_state_ol

  pinctrl-0:
    maxItems: 1

  pinctrl-1:
    maxItems: 1

  pinctrl-2:
    maxItems: 1

  pinctrl-3:
    maxItems: 1

required:
  - compatible
  - reg
  - interrupts
  - clocks
  - clock-names
  - power-domains
  - memory-region

additionalProperties: false

examples:
  - |
    #include <dt-bindings/interrupt-controller/arm-gic.h>
    #include <dt-bindings/interrupt-controller/irq.h>
    #include <dt-bindings/clock/mediatek,mt6785-clk.h>
    #include <dt-bindings/power/mediatek,mt6785-power.h>

    consys@18002000 {
        compatible = "mediatek,mt6785-consys";
        reg = <0 0x18002000 0 0x1000>,
              <0 0x10007000 0 0x0100>,
              <0 0x10001000 0 0x1000>,
              <0 0x10006000 0 0x1000>,
              <0 0x18007000 0 0x1000>,
              <0 0x180b1000 0 0x1000>,
              <0 0x180a3000 0 0x1000>,
              <0 0x180a5000 0 0x0800>,
              <0 0x180c1000 0 0x1000>,
              <0 0x18004000 0 0x1000>,
              <0 0x1024c000 0 0x0040>,
              <0 0x10003000 0 0x1000>;
        interrupts = <GIC_SPI 321 IRQ_TYPE_LEVEL_LOW>,
                     <GIC_SPI 78 IRQ_TYPE_LEVEL_LOW>,
                     <GIC_SPI 323 IRQ_TYPE_EDGE_RISING>;
        clocks = <&infracfg CLK_INFRA_CCIF4_AP>;
        clock-names = "ccif";
        power-domains = <&spm MT6785_POWER_DOMAIN_CONN>;
        memory-region = <&consys_reserved>;
        pmic = <&pmic>;
    };
```

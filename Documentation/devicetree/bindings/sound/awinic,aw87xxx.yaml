## drivers/gnss/Kconfig
```kconfig
# SPDX-License-Identifier: GPL-2.0-only
#
# GNSS receiver configuration
#

menuconfig GNSS
	tristate "GNSS receiver support"
	help
	  Say Y here if you have a GNSS receiver (e.g. a GPS receiver).

	  To compile this driver as a module, choose M here: the module will
	  be called gnss.

if GNSS

config GNSS_SERIAL
	tristate

config GNSS_MTK_SERIAL
	tristate "Mediatek GNSS receiver support"
	depends on SERIAL_DEV_BUS
	select GNSS_SERIAL
	help
	  Say Y here if you have a Mediatek-based GNSS receiver which uses a
	  serial interface.

	  To compile this driver as a module, choose M here: the module will
	  be called gnss-mtk.

	  If unsure, say N.

config GNSS_SIRF_SERIAL
	tristate "SiRFstar GNSS receiver support"
	depends on SERIAL_DEV_BUS
	help
	  Say Y here if you have a SiRFstar-based GNSS receiver which uses a
	  serial interface.

	  To compile this driver as a module, choose M here: the module will
	  be called gnss-sirf.

	  If unsure, say N.

config GNSS_UBX_SERIAL
	tristate "u-blox GNSS receiver support"
	depends on SERIAL_DEV_BUS
	select GNSS_SERIAL
	help
	  Say Y here if you have a u-blox GNSS receiver which uses a serial
	  interface.

	  To compile this driver as a module, choose M here: the module will
	  be called gnss-ubx.

	  If unsure, say N.

config GNSS_USB
	tristate "USB GNSS receiver support"
	depends on USB
	help
	  Say Y here if you have a GNSS receiver which uses a USB interface.

	  To compile this driver as a module, choose M here: the module will
	  be called gnss-usb.

	  If unsure, say N.

config MTK_STPGPS
	tristate "MediaTek GNSS bridge over the CONNSYS STP transport"
	depends on MTK_WMT_DRV
	help
	  Character-device bridge for the MediaTek CONNSYS GNSS engine, which is
	  a task on the conn MCU and ships its NMEA sentences as STP frames of
	  type 2. Provides /dev/stpgps for the data path and /dev/gps_emi as the
	  EMI window placeholder the vendor userspace daemon expects.

	  Say M here to build it as the stpgps module.

endif # GNSS
```

## drivers/iio/common/mtk_scp_sensors/Kconfig
```kconfig
# SPDX-License-Identifier: GPL-2.0-only
#
# MediaTek SCP sensor hub (sensors behind the SCP)
#

config MTK_SCP_SENSORS
	tristate "Mediatek SCP sensor hub"
	depends on IIO
	depends on MTK_SCP_CM4 || COMPILE_TEST
	help
	  Say y (or M) here to use the motion and environment sensors that are
	  attached to MediaTek's System Companion Processor instead of the AP:
	  on the MT6785 that is the accelerometer, the gyroscope, the
	  magnetometer, the ambient light sensors and the proximity sensor.
	  The SCP firmware drives the parts and this driver brings their data
	  out through /dev/hf_manager and as IIO devices.

	  It needs the SCP driver (MTK_SCP_CM4) to have loaded the firmware.

	  To compile this driver as a module, choose M here: the module is
	  called mtk-scp-sensors.
```

## drivers/iio/common/mtk_sensorhub/Kconfig
```kconfig
# SPDX-License-Identifier: GPL-2.0-only
config MTK_SENSORHUB
	tristate "MediaTek SCP sensor hub (IPI_SENSOR client and IIO front end)"
	depends on MTK_SCP
	depends on IIO
	help
	  Say yes here to expose the sensors behind MediaTek's SCP sensor hub as
	  IIO devices. The hub speaks MediaTek's own protocol over the SCP's
	  IPI id 8: control messages travel through the interrupt and the samples
	  themselves through a ring buffer in DRAM.

config MTK_SENSORHUB_KUNIT_TEST
	tristate "KUnit tests for the SCP sensorhub ring parser" if !KUNIT_ALL_TESTS
	depends on MTK_SENSORHUB || KUNIT_ALL_TESTS
	default KUNIT_ALL_TESTS
	help
	  Unit tests for the frame parsing of the SCP sensorhub ring, including a
	  corrupted frame. Run with tools/testing/kunit/kunit.py run.
```

## drivers/media/platform/mediatek/cam/Kconfig
```kconfig
# SPDX-License-Identifier: GPL-2.0-only
config VIDEO_MTK_CAM
	tristate "MediaTek camera pipeline core"
	depends on VIDEO_DEV && MEDIA_CONTROLLER && OF
	depends on ARCH_MEDIATEK || COMPILE_TEST
	select VIDEO_MTK_SENINF
	select VIDEO_MTK_CAMSV
	help
	  The camera pipeline of MediaTek SoCs is a chain of subdevices - the sensor on its I2C
	  bus, the CSI-2 receiver (SENINF) and the capture engine (CAMSV) - described by the device
	  tree graph. This core owns the shared media device and the v4l2 device the others
	  register into, and creates the pad links between them.
```

## drivers/media/platform/mediatek/camsv/Kconfig
```kconfig
# SPDX-License-Identifier: GPL-2.0-only
config VIDEO_MTK_CAMSV
	tristate "MediaTek CAMSV raw capture"
	depends on VIDEO_DEV && VIDEO_V4L2_SUBDEV_API && OF
	depends on ARCH_MEDIATEK || COMPILE_TEST
	select VIDEOBUF2_DMA_CONTIG
	select V4L2_FWNODE
	help
	  The CAMSV engines capture raw Bayer frames from the camera muxes that
	  the SENINF receiver feeds, and write them to memory. This driver
	  implements one engine as a V4L2 video device with a single sink pad,
	  linked to the receiver's source pad through the media controller.
```

## drivers/media/platform/mediatek/seninf/Kconfig
```kconfig
# SPDX-License-Identifier: GPL-2.0-only
config VIDEO_MTK_SENINF
	tristate "MediaTek CSI-2 receiver (SENINF)"
	depends on VIDEO_DEV && OF
	depends on ARCH_MEDIATEK || COMPILE_TEST
	depends on VIDEO_MTK_CAM
	help
	  The SENINF is the CSI-2 receiver of MediaTek SoCs: it takes the D-PHY or
	  C-PHY lanes of a camera sensor and feeds the camera muxes that the capture
	  engines read from. This driver brings the receiver up and exposes its
	  packet and error counters, which is what a board needs while the sensor
	  side is being brought up.

	  Say M or Y here to have the receiver probed on the SoCs whose device tree
	  describes it.
```

## drivers/misc/mediatek/Kconfig
```kconfig
# SPDX-License-Identifier: GPL-2.0
#
# MediaTek vendor connectivity (WMT/STP/connsys) forward-port.
# Stage-1 of the begonia (MT6785) vendor-stack forward-port: get the
# 4.14 vendor WMT bring-up layer + vendor BTIF to compile on mainline.
#

config MTK_WMT_FWPORT
	tristate "MediaTek WMT/connsys vendor forward-port (begonia MT6785)"
	depends on ARCH_MEDIATEK || COMPILE_TEST
	depends on OF
	default n
	help
	  Forward-port of the MediaTek vendor connectivity stack
	  (WMT / STP / connsys platform + vendor BTIF) from the 4.14
	  begonia vendor kernel to mainline. This builds the wmt_drv
	  module (and the vendor BTIF as its own module) for conn-MCU
	  bring-up on the Xiaomi begonia (MT6785 / Helio G90T).

	  This is a work-in-progress bring-up vehicle, not an
	  upstreamable driver. Say N unless you are working on the
	  begonia connectivity forward-port.

if MTK_WMT_FWPORT

source "drivers/misc/mediatek/connectivity/Kconfig"
source "drivers/misc/mediatek/btif/Kconfig"

endif # MTK_WMT_FWPORT
```

## drivers/misc/mediatek/connectivity/Kconfig
```kconfig
# SPDX-License-Identifier: GPL-2.0
#
# Vendor WMT/connsys (wmt_drv) forward-port for begonia (MT6785).
#

config MTK_WMT_DRV
	tristate "MediaTek WMT/connsys core driver (wmt_drv, vendor forward-port)"
	default MTK_WMT_FWPORT
	help
	  Vendor MediaTek WMT/STP/connsys bring-up driver (wmt_drv)
	  forward-ported from the 4.14 begonia vendor kernel. Drives the
	  connsys platform power/clk/EMI sequence and the conn-MCU
	  bring-up handshake on MT6785 (Helio G90T).

config MTK_WLAN_GEN4M
	tristate "MediaTek gen4m fullmac WLAN driver (wlan0, vendor forward-port)"
	depends on MTK_WMT_DRV
	depends on CFG80211
	default MTK_WMT_FWPORT
	help
	  Vendor MediaTek gen4m fullmac (cfg80211) WLAN driver, forward-ported
	  from the 4.14 begonia vendor kernel. Registers wlan0 and sits on top
	  of the WMT/connsys (wmt_drv) bring-up stack. Scoped to the begonia
	  config subset: CONNAC (connac1.0) AXI-HIF, chip 6785, WIFI_IP_SET=2.
```

## drivers/net/wwan/rosemary_ccci/Kconfig
```kconfig
# SPDX-License-Identifier: GPL-2.0-only
#
# MediaTek MT6785 (Poco M5s / rosemary) modem: CCCI over CCIF.

config ROSEMARY_CCCI
	tristate "MediaTek MT6785 modem (CCCI over CCIF, Poco M5s)"
	depends on ARCH_MEDIATEK
	help
	  The MediaTek MT6785 has a second processor for the modem (MD1,
	  generation 6295) that the AP reaches only through the CCIF control
	  transport and the DPMAIF packet transport. This driver powers the
	  modem's MTCMOS domain, reads the memory layout the bootloader hands
	  over, restarts the modem, answers its boot handshakes and exposes its
	  channels: the AT port, the NVRAM file service, the RPC service and
	  the packet data netdevs.

	  Say M here for the Poco M5s port. If unsure, say N.
```

## drivers/tee/microtrust/Kconfig
```kconfig
# SPDX-License-Identifier: GPL-2.0-only
config MICROTRUST_TEEI
	tristate "Microtrust SOTER (iSee) TEE client driver"
	depends on OF
	depends on DMA_SHARED_BUFFER
	help
	  Driver for the normal-world side of Microtrust's SOTER (iSee) secure
	  OS, as used on MediaTek SoCs. It brings up the shared queues between
	  the two worlds, keeps a pool of memory the secure world can read, and
	  exposes the TEE client, the trusted-application file service and the
	  fingerprint client to user space (/dev/teei_client, /dev/tz_vfs,
	  /dev/teei_fp and /dev/teei_config).

	  Its own client API is built in, so the kernel's generic TEE subsystem
	  is not required. This is vendor code carried over from the phone's
	  GPL kernel: it is not upstreamable and only builds against the
	  Microtrust secure OS of the matching board.

	  Say M to build it as the module microtrust_teei. The device tree node
	  it binds to (microtrust,utos) is disabled by default: a wrong secure
	  world description freezes the phone at boot.
```

## Documentation/devicetree/bindings/sound/awinic,aw87xxx.yaml
```yaml
# SPDX-License-Identifier: (GPL-2.0-only OR BSD-2-Clause)
%YAML 1.2
---
$id: http://devicetree.org/schemas/sound/awinic,aw87xxx.yaml#
$schema: http://devicetree.org/meta-schemas/core.yaml#

title: Awinic AW87xxx smart speaker amplifier

maintainers:
  - MediaTek SoC Team <linux-mediatek@lists.infradead.org>

description: |
  The AW87xxx family (AW87339, AW87359, AW87369, AW87519, AW87559) are Class-D
  speaker amplifiers that take their audio in analog from the codec and are
  programmed over I2C with a per-scene register profile. The part on the bus is
  detected by reading register 0x00, and the profile file name carries the
  detected id and the amplifier's channel, so a board with two of them needs
  only the channel number here.

  The amplifier is a sink in the sound card's DAPM graph: the machine driver
  routes the codec's output into the "Amp" widget this driver registers, and
  that widget's power events load the music scene on power up and the off scene
  on power down. sound-name-prefix makes the widget name unique on boards with
  more than one amplifier.

properties:
  compatible:
    const: awinic,aw87xxx

  reg:
    maxItems: 1

  reset-gpios:
    description: The part's reset pin, active low, when the board wires one.

  awinic,pa-channel:
    $ref: /schemas/types.yaml#/definitions/uint32
    description: |
      The amplifier's channel number, which the firmware profile file name
      carries (aw87xxx_pid_<id>_<scene>_<channel>.bin).
    enum: [0, 1]

  sound-name-prefix:
    $ref: /schemas/types.yaml#/definitions/string
    description: Prefix for the DAPM widget name, so two amplifiers differ.

required:
  - compatible
  - reg
  - awinic,pa-channel

additionalProperties: false

examples:
  - |
    #include <dt-bindings/gpio/gpio.h>

    pio: pinctrl {
        gpio-controller;
        #gpio-cells = <2>;
    };

    i2c {
        #address-cells = <1>;
        #size-cells = <0>;

        speaker@58 {
            compatible = "awinic,aw87xxx";
            reg = <0x58>;
            awinic,pa-channel = <1>;
            sound-name-prefix = "Spk";
        };

        earpiece@5b {
            compatible = "awinic,aw87xxx";
            reg = <0x5b>;
            reset-gpios = <&pio 24 GPIO_ACTIVE_LOW>;
            awinic,pa-channel = <0>;
            sound-name-prefix = "Rcv";
        };
    };

...
```

## Documentation/devicetree/bindings/sound/mediatek,mt6359-accdet.yaml
```yaml
# SPDX-License-Identifier: (GPL-2.0-only OR BSD-2-Clause)
%YAML 1.2
---
$id: http://devicetree.org/schemas/sound/mediatek,mt6359-accdet.yaml#
$schema: http://devicetree.org/meta-schemas/core.yaml#

title: MediaTek MT6359 accessory detection (ACCDET)

maintainers:
  - MediaTek SoC Team <linux-mediatek@lists.infradead.org>

description: |
  The accessory detection block of the MT6359 PMIC: it sees the headset being
  plugged in and out, tells a headphone from a headset with a microphone, and
  measures the headset's buttons. It is an MFD child of the PMIC node, which
  provides its interrupts; nothing here is on an AP bus.

properties:
  compatible:
    const: mediatek,mt6359-accdet

  mediatek,mic-vol:
    $ref: /schemas/types.yaml#/definitions/uint32
    description: Microphone bias voltage code.
    maximum: 15

  mediatek,mic-mode:
    $ref: /schemas/types.yaml#/definitions/uint32
    description: |
      Microphone bias mode: 1 for the standard bias, 2 for the low-cost mode
      with the internal resistor.

  mediatek,plugout-debounce:
    $ref: /schemas/types.yaml#/definitions/uint32
    description: Plug-out debounce setting.

  mediatek,pwm-deb-setting:
    $ref: /schemas/types.yaml#/definitions/uint32-array
    minItems: 15
    maxItems: 15
    description: |
      The fifteen debounce words of the block: the auxiliary-ADC debounce, the
      end-of-debounce value, the PWM widths and the button thresholds' timing.

  mediatek,eint-level-pol:
    $ref: /schemas/types.yaml#/definitions/uint32
    description: Level polarity of the detection interrupt.

  mediatek,eint-use-ap:
    $ref: /schemas/types.yaml#/definitions/uint32
    enum: [0, 1]
    description: |
      0 routes the detection interrupt through the PMIC (the picture on this
      board), 1 through a GPIO of the SoC.

  mediatek,eint-detect-mode:
    $ref: /schemas/types.yaml#/definitions/uint32
    description: Detection mode; 4 is the hardware mode.

  mediatek,eint-num:
    $ref: /schemas/types.yaml#/definitions/uint32
    enum: [0, 1, 2]
    description: Which PMIC EINT line carries the detection - 0, 1 or both.

  mediatek,eint-trig-mode:
    $ref: /schemas/types.yaml#/definitions/uint32
    enum: [0, 1]
    description: Trigger through the GPIO block (0) or through the inverter (1).

  mediatek,eint-use-ext-res:
    $ref: /schemas/types.yaml#/definitions/uint32
    enum: [0, 1]
    description: Use the external (1) or the internal (0) reference resistor.

  mediatek,eint-comp-vth:
    $ref: /schemas/types.yaml#/definitions/uint32
    description: Comparator threshold of the detection.

  mediatek,key-mode:
    $ref: /schemas/types.yaml#/definitions/uint32
    enum: [0, 1, 2]
    description: |
      Headset button arrangement: 0 for three buttons, 1 for four, 2 for the
      three-button CDD thresholds.

  mediatek,three-key-thr:
    $ref: /schemas/types.yaml#/definitions/uint32-array
    minItems: 4
    maxItems: 4
    description: The four thresholds of a three-button headset, ending with the open value.

  mediatek,four-key-thr:
    $ref: /schemas/types.yaml#/definitions/uint32-array
    minItems: 5
    maxItems: 5
    description: The five thresholds of a four-button headset, ending with the open value.

  mediatek,tri-key-cdd-thr:
    $ref: /schemas/types.yaml#/definitions/uint32-array
    minItems: 4
    maxItems: 4
    description: The three-button CDD thresholds.

additionalProperties: false

examples:
  - |
    pmic {
        accdet {
            compatible = "mediatek,mt6359-accdet";

            mediatek,mic-vol = <8>;
            mediatek,mic-mode = <2>;
            mediatek,plugout-debounce = <1>;
            mediatek,eint-use-ap = <0>;
            mediatek,eint-detect-mode = <4>;
            mediatek,key-mode = <0>;
            mediatek,three-key-thr = <0 80 220 400>;
        };
    };

...
```

## Documentation/devicetree/bindings/sound/mediatek,mt6785-afe-pcm.yaml
```yaml
# SPDX-License-Identifier: (GPL-2.0-only OR BSD-2-Clause)
%YAML 1.2
---
$id: http://devicetree.org/schemas/sound/mediatek,mt6785-afe-pcm.yaml#
$schema: http://devicetree.org/meta-schemas/core.yaml#

title: MediaTek MT6785 audio front end

maintainers:
  - MediaTek SoC Team <linux-mediatek@lists.infradead.org>

description: |
  The audio front end of the MT6785 moves PCM between memory (through its
  memory interfaces) and the codec, the I2S ports and the PCM/TDM interfaces.
  It is a child of the SoC's audio system controller, which is the syscon its
  register map comes from, so it carries no reg of its own.

properties:
  compatible:
    const: mediatek,mt6785-audio

  interrupts:
    maxItems: 1

  resets:
    maxItems: 1

  reset-names:
    const: audiosys

  mediatek,apmixedsys:
    $ref: /schemas/types.yaml#/definitions/phandle
    description: The APMIXEDSYS controller, where the audio PLLs live.

  mediatek,infracfg:
    $ref: /schemas/types.yaml#/definitions/phandle
    description: The infrastructure clock controller.

  mediatek,topckgen:
    $ref: /schemas/types.yaml#/definitions/phandle
    description: The top clock generator, where the audio muxes live.

  power-domains:
    maxItems: 1

  "#sound-dai-cells":
    const: 0

  clocks: true
  clock-names: true

  pinctrl-names: true

patternProperties:
  # the MTKAIF pin states the driver looks up by name (mt6785-afe-gpio.c)
  '^pinctrl-[0-9]+$': true

required:
  - compatible
  - interrupts
  - resets
  - reset-names
  - mediatek,apmixedsys
  - mediatek,infracfg
  - mediatek,topckgen
  - power-domains
  - "#sound-dai-cells"

additionalProperties: false

examples:
  - |
    #include <dt-bindings/interrupt-controller/arm-gic.h>

    audsys: syscon@11210000 {
        compatible = "mediatek,mt6785-audsys", "syscon";
        reg = <0x11210000 0x1000>;
        #clock-cells = <1>;

        audio-controller {
            compatible = "mediatek,mt6785-audio";
            interrupts = <GIC_SPI 184 IRQ_TYPE_LEVEL_LOW>;
            resets = <&watchdog 17>;
            reset-names = "audiosys";
            mediatek,apmixedsys = <&apmixedsys>;
            mediatek,infracfg = <&infracfg>;
            mediatek,topckgen = <&topckgen>;
            power-domains = <&spm 0>;
            #sound-dai-cells = <0>;
        };
    };

    watchdog: watchdog@10007000 {
        reg = <0x10007000 0x100>;
        #reset-cells = <1>;
    };

    apmixedsys: clock-controller@1000c000 {
        reg = <0x1000c000 0x1000>;
        #clock-cells = <1>;
    };

    infracfg: clock-controller@10001000 {
        reg = <0x10001000 0x1000>;
        #clock-cells = <1>;
    };

    topckgen: clock-controller@10000000 {
        reg = <0x10000000 0x1000>;
        #clock-cells = <1>;
    };

    spm: power-controller@10006000 {
        reg = <0x10006000 0x1000>;
        #power-domain-cells = <1>;
    };

...
```

## Documentation/devicetree/bindings/sound/mediatek,mt6785-mt6359.yaml
```yaml
# SPDX-License-Identifier: (GPL-2.0-only OR BSD-2-Clause)
%YAML 1.2
---
$id: http://devicetree.org/schemas/sound/mediatek,mt6785-mt6359.yaml#
$schema: http://devicetree.org/meta-schemas/core.yaml#

title: MediaTek MT6785 sound card with the MT6359 codec

maintainers:
  - MediaTek SoC Team <linux-mediatek@lists.infradead.org>

description: |
  A sound card that pairs the MT6785 audio front end with the MT6359 codec in
  the PMIC, optional auxiliary components (amplifiers that are not DAIs, such as
  the Awinic AW87xxx), and a headset jack on the codec's accessory detection
  block.

properties:
  compatible:
    const: mediatek,mt6785-mt6359-sound

  model:
    $ref: /schemas/types.yaml#/definitions/string
    description: The card's name, as shown to user space.

  mediatek,platform:
    $ref: /schemas/types.yaml#/definitions/phandle
    description: The audio front end the card's front-end DAIs belong to.

  mediatek,accdet:
    $ref: /schemas/types.yaml#/definitions/phandle
    description: |
      The PMIC node whose child is the codec's accessory detection block. The
      machine driver takes that component from it and hands it the headset jack
      it publishes.

  aux-devs:
    $ref: /schemas/types.yaml#/definitions/phandle-array
    description: |
      Amplifiers that are part of the card's DAPM graph without being DAIs;
      each one must be a component registering the widgets the card's
      audio-routing names.

  audio-routing:
    $ref: /schemas/types.yaml#/definitions/non-unique-string-array
    description: |
      A list of (sink, control, source) triples, as the ASoC core's
      snd_soc_of_parse_audio_routing() reads them.

required:
  - compatible
  - mediatek,platform

additionalProperties: true

examples:
  - |
    afe: audio-controller {
        compatible = "mediatek,mt6785-audio";
        #sound-dai-cells = <0>;
    };

    pmic: pmic {
        compatible = "mediatek,mt6359";

        accdet {
            compatible = "mediatek,mt6359-accdet";
        };
    };

    i2c {
        #address-cells = <1>;
        #size-cells = <0>;

        speaker_amp: speaker@58 {
            compatible = "awinic,aw87xxx";
            reg = <0x58>;
            awinic,pa-channel = <0>;
            sound-name-prefix = "Spk";
        };

        receiver_amp: receiver@5b {
            compatible = "awinic,aw87xxx";
            reg = <0x5b>;
            awinic,pa-channel = <1>;
            sound-name-prefix = "Rcv";
        };
    };

    sound {
        compatible = "mediatek,mt6785-mt6359-sound";
        model = "Xiaomi POCO M5s";
        mediatek,platform = <&afe>;
        mediatek,accdet = <&pmic>;
        aux-devs = <&speaker_amp>, <&receiver_amp>;

        audio-routing = "Spk Amp", "LINEOUT L",
                        "Rcv Amp", "Receiver";
    };

...
```

## Documentation/devicetree/bindings/tee/microtrust,utos.yaml
```yaml
# SPDX-License-Identifier: (GPL-2.0-only OR BSD-2-Clause)
%YAML 1.2
---
$id: http://devicetree.org/schemas/tee/microtrust,utos.yaml#
$schema: http://devicetree.org/meta-schemas/core.yaml#

title: Microtrust SOTER / iSee secure world notification interrupts

maintainers:
  - Poco M5s Linux port <noreply@example.invalid>

description: |
  Microtrust's SOTER (iSee) secure OS runs on some MediaTek SoCs next to the
  normal world and signals it over dedicated, edge-triggered GIC interrupts.
  The node has no register range: the secure world owns every register it
  needs, and the normal world only registers a handler for the notification
  lines so that the Microtrust client driver can be told about user-TA events.

  The interrupt numbers are board specific. On the POCO M5s (MT6785) they are
  GIC_SPI 91 and 92, the same two lines the vendor SoC description of this chip
  declares ("Microtrust SW IRQ number 91(123) ~ 95(127)" in the vendor
  mt6785.dts).

properties:
  compatible:
    const: microtrust,utos

  interrupts:
    minItems: 2
    maxItems: 2
    description: |
      The notification lines of the secure world, edge triggered on the rising
      edge. The Microtrust client driver registers a handler on the first one;
      the second carries the additional user-TA notification the platform
      declares.

required:
  - compatible
  - interrupts

additionalProperties: false

examples:
  - |
    #include <dt-bindings/interrupt-controller/arm-gic.h>
    #include <dt-bindings/interrupt-controller/irq.h>

    utos {
      compatible = "microtrust,utos";
      interrupts = <GIC_SPI 91 IRQ_TYPE_EDGE_RISING>,
                   <GIC_SPI 92 IRQ_TYPE_EDGE_RISING>;
    };

...
```
